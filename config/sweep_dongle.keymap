/*
 * Раскладка донгла. В схеме «донгл = central» keymap исполняется здесь, а не
 * на половинках, поэтому это тот же самый файл, что раньше собирался в
 * cradio_left — включаем его, чтобы источник правды остался один.
 *
 * Побочный, но нужный эффект: биндинги &bt на третьем слое теперь
 * переключают BLE-профили донгла, то есть служат пультом выбора хоста.
 */

#include "cradio.keymap"
